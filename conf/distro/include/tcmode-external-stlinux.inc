## conf/distro/include/tcmode-external-stlinux.inc
```bitbake
#
# Configuration to use external STLinux toolchain
#

EXTERNAL_TOOLCHAIN ?= "${STAGING_DIR_TARGET}"

TOOLCHAIN_PATH_ADD = "${EXTERNAL_TOOLCHAIN}/bin:"
PATH =. "${TOOLCHAIN_PATH_ADD}"

STL_TARGET_SYS_sh4 ?= "sh4-linux"
STL_TARGET_SYS = "${TARGET_SYS}"

TARGET_PREFIX = "${STL_TARGET_SYS}-"

PREFERRED_PROVIDER_linux-libc-headers = "external-stlinux-toolchain"
PREFERRED_PROVIDER_linux-libc-headers-dev = "external-stlinux-toolchain"
PREFERRED_PROVIDER_virtual/${TARGET_PREFIX}gcc = "external-stlinux-toolchain"
PREFERRED_PROVIDER_virtual/${TARGET_PREFIX}gcc-initial = "external-stlinux-toolchain"
PREFERRED_PROVIDER_virtual/${TARGET_PREFIX}gcc-intermediate = "external-stlinux-toolchain"
PREFERRED_PROVIDER_virtual/${TARGET_PREFIX}g++ = "external-stlinux-toolchain"
PREFERRED_PROVIDER_virtual/${TARGET_PREFIX}binutils = "external-stlinux-toolchain"
PREFERRED_PROVIDER_virtual/${TARGET_PREFIX}libc-for-gcc = "external-stlinux-toolchain"
PREFERRED_PROVIDER_virtual/${TARGET_PREFIX}compilerlibs = "external-stlinux-toolchain"
PREFERRED_PROVIDER_libgcc = "external-stlinux-toolchain"
PREFERRED_PROVIDER_virtual/libc = "external-stlinux-toolchain"
PREFERRED_PROVIDER_virtual/libintl = "external-stlinux-toolchain"
PREFERRED_PROVIDER_virtual/libiconv = "external-stlinux-toolchain"
PREFERRED_PROVIDER_glibc-thread-db = "external-stlinux-toolchain"
PREFERRED_PROVIDER_virtual/linux-libc-headers = "external-stlinux-toolchain"
PREFERRED_PROVIDER_gdbserver ??= "external-stlinux-toolchain"

# No need to re-compile the locale files
GLIBC_INTERNAL_USE_BINARY_LOCALE = "precompiled"
ENABLE_BINARY_LOCALE_GENERATION = ""

TOOLCHAIN_OPTIONS = " --sysroot=${STAGING_DIR_HOST}"

# Point to the appropriate multilib sysroot from the external toolchain, whose
# files will be extracted into the OE sysroot
def exttc_run(d, cmd):
    try:
        return bb.process.run(cmd, shell=True, env={'PATH': d.getVar('PATH', True)})[0].rstrip()
    except (OSError, bb.process.CmdError):
        return ''

EXTERNAL_TOOLCHAIN_SYSROOT_CMD = "${TARGET_PREFIX}gcc ${TARGET_CC_ARCH} -print-sysroot"
EXTERNAL_TOOLCHAIN_SYSROOT ??= "${@exttc_run(d, EXTERNAL_TOOLCHAIN_SYSROOT_CMD)}"

# These bits are here temporarily to sidestep the need to use a separate set
# of tune files to pass the appropriate multilib selection arguments to the
# stlinux toolchain, as is needed to extract the sysroot content.
TUNE_CCARGS_append_x86 = " -msgxx-glibc"

def csl_multilib_arg(d):
    argument = d.getVarFlag('STL_MULTILIB_ARGS', d.getVar('DEFAULTTUNE', True) or '')
    if argument:
        return argument
    else:
        return ''

EXTERNAL_TOOLCHAIN_SYSROOT_CMD += "${@csl_multilib_arg(d)}"


# Unfortunately, the STL ia32 toolchain has non-prefixed binaries in its
# bindir (e.g. gcc, ld). To avoid this messing up our build, we avoid adding
# this bindir to our PATH, and instead add symlinks to the prefixed binaries
# to our staging toolchain bindir.

python toolchain_metadata_setup () {
    if not isinstance(e, bb.event.ConfigParsed):
        return

    d = e.data

    l = d.createCopy()
    l.finalize()
    if os.path.exists(bb.data.expand('${EXTERNAL_TOOLCHAIN}/bin/gcc', l)):
        d.setVar('TOOLCHAIN_PATH_ADD', '')
}
addhandler toolchain_metadata_setup

python toolchain_setup () {
    if not isinstance(e, bb.event.BuildStarted):
        return

    d = e.data

    if not d.getVar('TOOLCHAIN_PATH_ADD', True):
        populate_toolchain_links(d)
}
addhandler toolchain_setup

def populate_toolchain_links(d):
    import errno
    from glob import glob

    d = d.createCopy()
    d.finalize()

    pattern = d.expand('${EXTERNAL_TOOLCHAIN}/bin/${TARGET_PREFIX}*')
    files = glob(pattern)
    if not files:
        bb.fatal("Unable to populate toolchain binary symlinks in %s" % pattern)

    bindir = d.getVar('STAGING_BINDIR_TOOLCHAIN', True)
    bb.mkdirhier(bindir)
    for f in files:
        base = os.path.basename(f)
        newpath = os.path.join(bindir, base)
        try:
            os.symlink(f, newpath)
        except OSError as exc:
            if exc.errno == errno.EEXIST:
                break
            bb.fatal("Unable to populate toolchain binary symlink for %s: %s" % (newpath, exc))

#require conf/distro/include/csl-versions.inc
```

## conf/layer.conf
```bitbake
# We have a conf and classes directory, append to BBPATH
BBPATH .= ":${LAYERDIR}"

# We have a recipes directory containing .bb and .bbappend files, add to BBFILES
BBFILES := "${BBFILES} ${LAYERDIR}/recipes*/*/*.bb \ 
            ${LAYERDIR}/recipes*/*/*.bbappend"

BBFILE_COLLECTIONS += "spark"
BBFILE_PATTERN_spark := "^${LAYERDIR}/"
BBFILE_PRIORITY_spark = "6"

ST-LINUX_BASE := "${@os.path.normpath("${LAYERDIR}/../")}"

BINARY_FDMA_FW_PATH ?= "${LAYERDIR}/data/fdma_fw"
BINARY_STMFB_FW_PATH ?= "${LAYERDIR}/data/stmfb_fw"
BINARY_STSLAVE_FW_PATH ?= "${LAYERDIR}/data/stslave_fw"

BBMASK = "/linux-(yocto|dummy)|eglibc-"
TCLIBC ?= "glibc"
GLIBCVERSION ?= "2.10"
```

## conf/machine/include/spark_base.inc
```bitbake
require conf/machine/include/tune-sh4.inc
TARGET_ARCH = "sh4"
STLINUX_SH_UPD_SRPMS = "http://ftp.stlinux.com/pub/stlinux/2.4/updates/SRPMS"
STLINUX_SH_UPD_RPMS = "http://ftp.stlinux.com/pub/stlinux/2.4/updates/RPMS/sh4/"
STM_PATCH_STR ??= "0211"
LINUX_VERSION ??= "2.6.32.59"

PREFERRED_VERSION_stlinux24-${MACHINE} = "${LINUX_VERSION}-stm24-${STM_PATCH_STR}"
PREFERRED_VERSION_linux-libc-headers = "2.6.32"
PREFERRED_PROVIDER_virtual/kernel = "stlinux24-${MACHINE}"
PREFERRED_PROVIDER_openssl = "openssl"
PREFERRED_PROVIDER_libcrypto = "openssl"
PREFERRED_PROVIDER_libssl = "openssl"
#PREFERRED_PROVIDER_virtual/nativesdk-libc = "nativesdk-glibc"
#PREFERRED_PROVIDER_virtual/nativesdk-libiconv = "nativesdk-libiconv"
#PREFERRED_PROVIDER_virtual/nativesdk-libintl = "nativesdk-gettext"
#PREFERRED_VERSION_glibc = "2.10"
#PREFERRED_VERSION_glibc                   ?= "${GLIBCVERSION}"
#PREFERRED_VERSION_glibc-locale            ?= "${GLIBCVERSION}"
#PREFERRED_VERSION_glibc-nativesdk         ?= "2.10"
#PREFERRED_VERSION_glibc-initial           ?= "${GLIBCVERSION}"
#PREFERRED_VERSION_glibc-initial-nativesdk ?= "2.10"

USE_VT = "0"
MACHINE_FEATURES = "kernel26 ext2 alsa ext3 usbhost serial"

SERIAL_CONSOLE = "115200 ttyAS0"

KERNEL_IMAGETYPE = "uImage"

# save some extra space, kernel has its own mtd partion 
RDEPENDS_kernel-base = ""

UBI_VOLNAME = "rootfs"
MKUBIFS_ARGS = "-m 2048 -e 129024 -c 638   -F"
UBINIZE_ARGS = "-m 2048 -p 128KiB -O 512"

JFFS2_ERASEBLOCK = "0x20000"
JFFS2_ENDIANNESS = "${@base_conditional('SITEINFO_ENDIANNESS', 'le', '--little-endian', '--big-endian', d)}"
EXTRA_IMAGECMD_jffs2 = "--pad ${JFFS2_ENDIANNESS} --eraseblock=${JFFS2_ERASEBLOCK} --no-cleanmarkers"

INHERIT += "usb_image-spark71xx"
IMAGE_FSTYPES ?= "tar.gz ubi ext2 jffs2 spark71xx-usbimg"

IMAGE_CLASSES += "usb_image-spark71xx"
INITRAMFS_FSTYPES = "ext2.gz spark-updt"

MACHINE_EXTRA_RRECOMMENDS = "kernel-modules"

MACHINE_ESSENTIAL_EXTRA_RDEPENDS += " \
                                     stlinux24-sh4-stx7111-fdma-firmware \
                                     stlinux24-sh4-stmfb-firmware-stx7111 \
                                     stslave-fw \
                                     fp-control \
                                     stfbcontrol \
                                     ustslave \
                                     libmmeimage \
                                     lirc \
                                     lrzsz \
                                     mtd-utils \
                                     mtd-utils-jffs2 \
                                     mtd-utils-ubifs \
                                     mtd-utils-misc \
                                     tdt-driver \
"

##
## We have a RTC in aotom thx to seife.
## I have to check for removale 
## 
#Spark Boxes have no hardware clock
MACHINE_FEATURES_BACKFILL_CONSIDERED = "rtc"


##
## This would not work unless the kernel supports open by handle syscall
## http://lwn.net/Articles/390863/ 
##
#DISTRO_FEATURES_append = " systemd"
#VIRTUAL-RUNTIME_init_manager = "systemd"
#DISTRO_FEATURES_BACKFILL_CONSIDERED = "sysvinit"

##
## gcc-4.8 as in dora or newer (yocto-1.5+) will fail compiling the kernel
## with "error: 'asm' operand requires impossible reload"
## seems to be http://gcc.gnu.org/bugzilla/show_bug.cgi?id=58314
## which is not fixed in any released 4.8.x, so just use 4.7 for now:
##
GCCVERSION ?= "4.7%"
```

## conf/machine/spark.conf
```bitbake
require conf/machine/include/spark_base.inc

MACHINE_ESSENTIAL_EXTRA_RDEPENDS += " \
	stlinux24-sh4-stmfb-firmware-stx7111 \
        kernel-modules-tdt \	
	kernel-module-uinput \
"

module_autoload_autofs4 = "autofs4"
module_autoload_uinput = "uinput"
module_autoload_aotom = "aotom"
module_autoload_e2_proc ="e2_proc"
module_autoload_stmcore_display_sti7111 = "stmcore_display_sti7111"
module_autoload_stmfb = "stmfb"
module_autoload_cpu_frequ = "cpu_frequ"
module_autoload_embxshell = "embxshell"
module_autoload_embxmailbox = "embxmailbox"
module_autoload_embxshm = "embxshm"
module_autoload_mme_host = "mme_host"
module_autoload_avs = "avs"
module_autoload_mmelog = "mmelog"
module_autoload_ksound = "ksound"
module_autoload_p2div64 = "p2div64"
module_autoload_stm_v4l2 = "stm_v4l2"
module_autoload_stmvout = "stmvout"
module_autoload_stmvbi = "stmvbi"
module_autoload_pseudocard = "pseudocard"
module_autoload_stv090x = "stv090x"
module_autoload_pti = "pti"
module_autoload_stm_monitor = "stm_monitor"
module_autoload_stmsysfs = "stmsysfs"
module_autoload_stmdvb = "stmdvb"
module_autoload_player2 = "player2"
module_autoload_sth264pp = "sth264pp"
module_autoload_stmalloc = "stmalloc"
module_autoload_platform = "platform"
module_autoload_silencegen = "silencegen"
module_autoload_bpamem = "bpamem"
module_autoload_smartcard = "smartcard"


module_conf_stmfb = "options stmfb display0=1280x720-32@50:12m:pal:yuv:yuv"
module_conf_embxmailbox = "options embxmailbox mailbox0=0xfe211000:136:set2 mailbox1=0xfe212000:0"
module_conf_embxshm = "options embxshm mailbox0=shm:0:7:0x60000000:0:256:256:0:512:0x40000000:0x10000000"
module_conf_mme_host = "options mme_host transport0=shm"
module_conf_avs = "options avs type=avs_pio"
module_conf_pti = "options pti waitMS=20 videoMem=4096"
module_conf_player2 = "options player2 discardlateframe=0"
```

## conf/machine/spark7162.conf
```bitbake
require conf/machine/include/spark_base.inc

MACHINE_NAME = "SPARK7162"
MACHINE_BRAND = "FULAN"
MACHINE_OEM = "spark7162"
BRAND_OEM = "FULAN"

MACHINE_ESSENTIAL_EXTRA_RDEPENDS += " \
	stlinux24-sh4-stmfb-firmware-stx7105 \
        tdt-driver \
	kernel-module-uinput \
"

module_autoload_autofs4 = "autofs4"
module_autoload_uinput = "uinput"
```
